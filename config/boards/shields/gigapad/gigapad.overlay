
/ {
        chosen {
            zmk,kscan = &default_kscan;
        };

        default_kscan: kscan {
            compatible = "zmk,kscan-gpio-direct";
            label = "default_kscan";
            input-gpios =
                <&xiao_d 2 (GPIO_ACTIVE_HIGH | GPIO_PULL_UP)>,
                <&xiao_d 3 (GPIO_ACTIVE_HIGH | GPIO_PULL_UP)>,
                <&xiao_d 4 (GPIO_ACTIVE_HIGH | GPIO_PULL_UP)>,
                <&xiao_d 5 (GPIO_ACTIVE_HIGH | GPIO_PULL_UP)>,
                <&xiao_d 6 (GPIO_ACTIVE_HIGH | GPIO_PULL_UP)>,
                <&gpio1 15 (GPIO_ACTIVE_LOW | GPIO_PULL_UP)>,
                <&gpio1 14 (GPIO_ACTIVE_HIGH | GPIO_PULL_UP)>,
               <&gpio1 14 (GPIO_ACTIVE_HIGH | GPIO_PULL_UP)>,
               <&gpio1 12 (GPIO_ACTIVE_HIGH | GPIO_PULL_UP)>;
        };
};



